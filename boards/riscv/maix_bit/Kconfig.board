## boards/riscv/maix_bit/Kconfig.board
```kconfig
# SPDX-License-Identifier: Apache-2.0

config BOARD_MAIX_BIT
	bool "MAIX BIT target"
	depends on SOC_RISCV_MAIX_BIT
```

## boards/riscv/maix_bit/Kconfig.defconfig
```kconfig
# SPDX-License-Identifier: Apache-2.0

if BOARD_MAIX_BIT

config BOARD
	default "maix_bit"

config SYS_CLOCK_TICKS_PER_SEC
	default 128

endif
```

## boards/riscv/wio_lite_riscv/Kconfig.board
```kconfig
# Copyright (c) 2023 Tada Hiroki <hirokin18931@gmail.com>
# SPDX-License-Identifier: Apache-2.0

config BOARD_WIO_LITE_RISCV
	bool "Wio Lite Riscv"
	depends on SOC_GD32VF103
```

## boards/riscv/wio_lite_riscv/Kconfig.defconfig
```kconfig
# Copyright (c) 2023 Tada, Hiroki <hirokin18931@gmail.com>

if BOARD_WIO_LITE_RISCV

config BOARD
	default "wio_lite_riscv"

endif # BOARD_WIO_LITE_RISCV
```

## boards/riscv/wio_lite_riscv/wio_lite_riscv_defconfig
```kconfig
# Sipeed longan nano Development Board Configuration
#
# Copyright (c) 2023 Tada, Hiroki <hirokin18931@gmail.com>
#
# SPDX-License-Identifier: Apache-2.0

CONFIG_SOC_SERIES_GD32VF103=y
CONFIG_SOC_GD32VF103=y
CONFIG_BOARD_WIO_LITE_RISCV=y

CONFIG_GD32_HXTAL_8MHZ=y

CONFIG_SERIAL=y
CONFIG_UART_INTERRUPT_DRIVEN=y

CONFIG_CONSOLE=y
CONFIG_UART_CONSOLE=y

CONFIG_GPIO=y
```

## boards/seeed/wio_lite_riscv/board.yml
```yaml
board:
  name: wio_lite_riscv
  full_name: Wio Lite Riscv
  vendor: seeed
  socs:
    - name: gd32vf103
```
